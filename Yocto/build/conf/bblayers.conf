## Yocto/build/conf/bblayers.conf
```bitbake
LCONF_VERSION = "7"
BBPATH = "${TOPDIR}"
BBFILES ?= ""
BBLAYERS ?= " \
  /home/jose/poky/meta \
  /home/jose/poky/meta-poky \
  /home/jose/poky/meta-yocto-bsp \
  /home/jose/poky/meta-raspberrypi \
  /home/jose/poky/meta-openembedded/meta-oe \
  /home/jose/poky/meta-openembedded/meta-python \
  /home/jose/poky/meta-openembedded/meta-networking \
  /home/jose/poky/meta-openembedded/meta-multimedia \
  /home/jose/poky/meta-robot \
  "
```

## Yocto/build/conf/local.conf
```bitbake
# --- Configuración de la Máquina ---
MACHINE = "raspberrypi4-64"
# --- Configuración del Sistema de Paquetes ---
PACKAGE_CLASSES ?= "package_rpm"
# --- Características de la Imagen ---
EXTRA_IMAGE_FEATURES ?= "debug-tweaks ssh-server-openssh empty-root-password allow-empty-password"
# --- Configuración de Hardware y Conectividad ---
ENABLE_UART = "1"
GPU_MEM = "128"
# Características del sistema operativo
DISTRO_FEATURES:append = " wifi bluetooth bluez5 alsa"
# Drivers y firmware RPi4
IMAGE_INSTALL:append = " \
    linux-firmware-rpidistro-bcm43455 \
    wpa-supplicant \
    kernel-modules \
    alsa-utils \
    mpg123 \
"
# Herramientas de desarrollo
IMAGE_INSTALL:append = " \
    python3 \
    python3-modules \
    cmake \
    gcc \
    g++ \
    binutils \
    libstdc++ \
    libstdc++-dev \
"
# Configuración de disco
DL_DIR ?= "${TOPDIR}/downloads"
SSTATE_DIR ?= "${TOPDIR}/sstate-cache"
# Licencias
LICENSE_FLAGS_ACCEPTED = "synaptics-killswitch commercial"
# Flask
IMAGE_INSTALL:append = " python3-flask python3-pip"
# GPIO
IMAGE_INSTALL:append = " libgpiod"
# Audio RPi4
RPI_EXTRA_CONFIG = "dtparam=audio=on"
INHERIT += "extrausers"
EXTRA_USERS_PARAMS = "usermod -p '\$1\$jrKf1ye5\$mg2DI8iiAd3aJQT/aW6N81' root;"
# PWM
RPI_EXTRA_CONFIG:append = "\ndtoverlay=pwm-2chan,pin=18,func=2,pin2=19,func2=2"
# HDMI forzado
RPI_EXTRA_CONFIG:append = "\nhdmi_force_hotplug=1"
RPI_EXTRA_CONFIG:append = "\nhdmi_group=1"
RPI_EXTRA_CONFIG:append = "\nhdmi_mode=4"
RPI_EXTRA_CONFIG:append = "\ndtoverlay=vc4-fkms-v3d"
# Overlays
RPI_KERNEL_DEVICETREE_OVERLAYS:append = " overlays/pwm-2chan.dtbo"
# Deshabilitar gold linker
PACKAGECONFIG:remove:pn-binutils = "gold"

PACKAGECONFIG:append:pn-mpg123 = " alsa"
```

## Yocto/meta-robot/conf/layer.conf
```bitbake
BBPATH .= ":${LAYERDIR}"
BBFILES += "${LAYERDIR}/recipes-*/*/*.bb \
            ${LAYERDIR}/recipes-*/*/*.bbappend"
BBFILE_COLLECTIONS += "meta-robot"
BBFILE_PATTERN_meta-robot = "^${LAYERDIR}/"
BBFILE_PRIORITY_meta-robot = "10"
LAYERVERSION_meta-robot = "4"
LAYERSERIES_COMPAT_meta-robot = "kirkstone"
```
